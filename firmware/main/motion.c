#include "motion.h"
#include "stepper.h"
#include "encoder.h"
#include "log_bus.h"
#include "esp_log.h"
#include "esp_timer.h"
#include "freertos/FreeRTOS.h"
#include "freertos/task.h"
#include "freertos/semphr.h"
#include "freertos/portmacro.h"
#include "driver/gpio.h"
#include "nvs.h"
#include "nvs_flash.h"
#include <math.h>
#include <string.h>

static const char *TAG = "motion";

/* ── Calibration defaults (see COORDINATES.md §4.1) ─────────────────────── */
#define CAL_NVS_NAMESPACE   "orbiter"
#define CAL_KEY_AZ          "az_zero_raw"
#define CAL_KEY_EL          "el_zero_raw"
#define CAL_DEFAULT_AZ_RAW  0.0f
#define CAL_DEFAULT_EL_RAW  138.296f

/* Elevation physical limits — enforced by HTTP layer; documented here for clarity. */
#define EL_MIN_DEG          (-36.0f)
#define EL_MAX_DEG          ( 90.0f)

/* ── Closed-loop position control ────────────────────────────────────────────
 *
 * `motion_move` is a velocity-mode P-controller. Each control tick reads the
 * output-shaft encoder, converts the angular error to a step rate, and slews
 * the stepper toward it. The encoder is the SOLE source of truth for position
 * — there is no steps-per-revolution constant and no open-loop step counting
 * (this is why the old SPR auto-calibration was removed: a closed loop does
 * not need to know how many steps make a degree).
 *
 * Concurrency: the loop runs on the motion_runner task and yields with
 * vTaskDelay every tick, so httpd and the /ws/log pump keep serving requests
 * for the whole duration of a move. Step pulses themselves are generated by
 * the stepper ISR timer, independent of this task.
 *
 * Tuning: CL_KP_* / CL_HZ_SLEW / CL_HZ_MAX_* are the knobs. Larger Kp = more
 * aggressive approach; CL_HZ_SLEW caps acceleration (prevents cold-start
 * stall); CL_HZ_MAX_* is the per-axis top speed. Adjust on real hardware.
 */
#define CL_TICK_MS          12      /* control period — ~83 Hz loop          */
#define CL_TOL_DEG          0.15f   /* arrival tolerance                      */
#define CL_IN_TOL_TICKS     3       /* consecutive in-tol ticks → settled     */
#define CL_HZ_MIN           60u     /* crawl step rate near the target        */
#define CL_HZ_SLEW          70u     /* max step-rate change per tick (accel)  */
#define CL_HZ_MAX_AZ        1050u   /* AZ top speed — light axis              */
#define CL_HZ_MAX_EL        175u    /* EL top speed — carries the whole arm
                                       (was 525; cut 3× per operator request
                                       — calibration sweeps were over-shooting
                                       and the AF lock had no chance to settle
                                       at the original speed)              */
#define CL_KP_AZ            130.0f  /* AZ gain: Hz of step rate per ° of error */
#define CL_KP_EL            70.0f   /* EL gain                                 */
#define CL_HARD_CAP_MS      60000u  /* ceiling when caller passes timeout_ms=0 */

/* ── State ──────────────────────────────────────────────────────────────── */
static motion_state_t  s_state = MOTION_IDLE;
static motion_pos_t    s_pos   = { .az_deg = 0.0f, .el_deg = 0.0f };
static SemaphoreHandle_t s_move_mutex;   /* prevents concurrent /move calls */
static SemaphoreHandle_t s_enc_mutex;    /* serialises encoder bus access (pose-tick vs move/state) */
static bool  s_motors_enabled = false;
static bool  s_spinning_az    = false;
static bool  s_spinning_el    = false;
static portMUX_TYPE s_spin_lk = portMUX_INITIALIZER_UNLOCKED;

/*
 * Calibration: raw encoder degrees that correspond to user_deg = 0 on each axis.
 * Loaded from NVS at boot, updated via motion_set_calibration() which also
 * persists to NVS. See COORDINATES.md §4.1.
 */
static float s_az_zero_raw = CAL_DEFAULT_AZ_RAW;
static float s_el_zero_raw = CAL_DEFAULT_EL_RAW;

/* ── Helpers ────────────────────────────────────────────────────────────── */

static const char *motion_state_str(motion_state_t s)
{
    switch (s) {
        case MOTION_IDLE:     return "idle";
        case MOTION_MOVING:   return "moving";
        case MOTION_SPINNING: return "spinning";
        case MOTION_ERROR:    return "error";
        default:              return "unknown";
    }
}

/* Encoder-bus-locked single-axis read. */
static esp_err_t encoder_read_locked(enc_axis_t ax, float *out)
{
    xSemaphoreTake(s_enc_mutex, portMAX_DELAY);
    esp_err_t e = encoder_read_angle(ax, out);
    xSemaphoreGive(s_enc_mutex);
    return e;
}

/** Shortest signed delta on a circle: returns value in (-180, +180]. */
static float angle_delta(float from, float to)
{
    return fmodf(to - from + 540.0f, 360.0f) - 180.0f;
}

/**
 * Azimuth: continuous, user-space wrapped into [0, 360).
 * See COORDINATES.md §3.1, §4.1.
 */
static float az_user_from_raw(float raw)
{
    return fmodf(raw - s_az_zero_raw + 360.0f, 360.0f);
}

/**
 * Elevation: bounded signed, user-space in (-180, +180] (then range-validated
 * to [-36, +90] at HTTP layer). See COORDINATES.md §3.2, §4.1.
 *
 * The AS5048A on EL is mounted such that raising the arm DECREASES raw
 * reading (opposite of AZ). We negate the (raw - zero) term so user_el
 * follows the conventional "+ = up" sense.
 */
static float el_user_from_raw(float raw)
{
    return fmodf(s_el_zero_raw - raw + 540.0f, 360.0f) - 180.0f;
}

/* ── NVS calibration load/save ──────────────────────────────────────────── */

static void calibration_load_from_nvs(void)
{
    nvs_handle_t h;
    if (nvs_open(CAL_NVS_NAMESPACE, NVS_READONLY, &h) != ESP_OK) {
        ESP_LOGI(TAG, "calibration NVS not initialised — using defaults "
                      "(az_zero=%.3f° el_zero=%.3f°)",
                 (double)s_az_zero_raw, (double)s_el_zero_raw);
        return;
    }
    size_t sz = sizeof(float);
    float v;
    if (nvs_get_blob(h, CAL_KEY_AZ, &v, &sz) == ESP_OK) s_az_zero_raw = v;
    sz = sizeof(float);
    if (nvs_get_blob(h, CAL_KEY_EL, &v, &sz) == ESP_OK) s_el_zero_raw = v;
    nvs_close(h);
    ESP_LOGI(TAG, "calibration loaded: az_zero=%.3f° el_zero=%.3f°",
             (double)s_az_zero_raw, (double)s_el_zero_raw);
}

static esp_err_t calibration_save_to_nvs(bool save_az, bool save_el)
{
    nvs_handle_t h;
    esp_err_t err = nvs_open(CAL_NVS_NAMESPACE, NVS_READWRITE, &h);
    if (err != ESP_OK) {
        ESP_LOGE(TAG, "nvs_open failed: %s", esp_err_to_name(err));
        return err;
    }
    if (save_az) {
        err = nvs_set_blob(h, CAL_KEY_AZ, &s_az_zero_raw, sizeof(float));
        if (err != ESP_OK) goto done;
    }
    if (save_el) {
        err = nvs_set_blob(h, CAL_KEY_EL, &s_el_zero_raw, sizeof(float));
        if (err != ESP_OK) goto done;
    }
    err = nvs_commit(h);
done:
    nvs_close(h);
    return err;
}

/* ── Public API ─────────────────────────────────────────────────────────── */

/*
 * Pose-tick task: broadcasts current pose + state via /ws/log at ~100 Hz so the
 * UI doesn't have to poll /state. Skipped silently if no WS clients.
 *
 * Three design rules — all driven by the SPI starvation incident where pose-tick
 * monopolised the encoder bus mutex and HTTP handlers timed out:
 *
 *   1. We use vTaskDelay (not vTaskDelayUntil) so each cycle ALWAYS sleeps a
 *      full period after work.
 *   2. We acquire s_enc_mutex with timeout 0 (try-lock). Pose updates are
 *      cosmetic — if motion_move or an HTTP handler is on the bus, just skip
 *      this tick and keep last known angle.
 *   3. The task runs BELOW httpd (priority 4 vs httpd's default 5) so the HTTP
 *      task always wins the scheduler; priority inheritance on the encoder
 *      mutex then briefly boosts pose-tick to finish its read.
 */
static void pose_tick_task(void *arg)
{
    (void)arg;
    /*
     * 25 Hz: balances UI smoothness against heap churn + httpd worker pressure.
     * Was 100 Hz, which at 4 WS clients meant ~400 frames/s through
     * httpd_queue_work with 2 mallocs per dispatch — fragmented the heap and
     * starved the single worker if any client TCP-stalled. 25 Hz is still
     * smoother than typical UI animation (60 fps but motion is slow enough)
     * and 4× less malloc/send pressure.
     */
    const TickType_t period = pdMS_TO_TICKS(40);
    for (;;) {
        vTaskDelay(period);

        float raw;
        if (xSemaphoreTake(s_enc_mutex, 0) == pdTRUE) {
            if (encoder_read_angle(ENC_AZ, &raw) == ESP_OK) s_pos.az_deg = az_user_from_raw(raw);
            xSemaphoreGive(s_enc_mutex);
        }
        if (xSemaphoreTake(s_enc_mutex, 0) == pdTRUE) {
            if (encoder_read_angle(ENC_EL, &raw) == ESP_OK) s_pos.el_deg = el_user_from_raw(raw);
            xSemaphoreGive(s_enc_mutex);
        }

        bool sp_az, sp_el;
        portENTER_CRITICAL(&s_spin_lk);
        sp_az = s_spinning_az;
        sp_el = s_spinning_el;
        portEXIT_CRITICAL(&s_spin_lk);

        log_bus_emit_pose(s_pos.az_deg, s_pos.el_deg,
                          motion_state_str(s_state),
                          s_motors_enabled, sp_az, sp_el);
    }
}

void motion_init(void)
{
    s_move_mutex = xSemaphoreCreateMutex();
    s_enc_mutex  = xSemaphoreCreateMutex();
    stepper_init();
    calibration_load_from_nvs();

    if (encoder_init() == ESP_OK) {
        float raw;
        if (encoder_read_locked(ENC_AZ, &raw) == ESP_OK) s_pos.az_deg = az_user_from_raw(raw);
        if (encoder_read_locked(ENC_EL, &raw) == ESP_OK) s_pos.el_deg = el_user_from_raw(raw);
        LOGX_EMIT_I(TAG, "encoder seed: AZ=%.2f° EL=%.2f°", (double)s_pos.az_deg, (double)s_pos.el_deg);
    } else {
        LOGX_EMIT_W(TAG, "encoder init failed — closed-loop move unavailable");
    }

    stepper_enable();
    s_motors_enabled = true;

    /* Pose stream — broadcast az/el/state @~10 Hz to /ws/log subscribers.
     * Priority 4 — deliberately below httpd (5); see pose_tick_task preamble. */
    xTaskCreate(pose_tick_task, "pose_tick", 4096, NULL, 4, NULL);

    LOGX_EMIT_I(TAG, "motion init OK");
}

motion_state_t motion_get_state(void) { return s_state; }

motion_pos_t motion_get_position(void)
{
    motion_pos_t pos = s_pos;
    float raw;
    if (encoder_read_locked(ENC_AZ, &raw) == ESP_OK) pos.az_deg = az_user_from_raw(raw);
    if (encoder_read_locked(ENC_EL, &raw) == ESP_OK) pos.el_deg = el_user_from_raw(raw);
    return pos;
}

void motion_set_motors(bool enabled)
{
    s_motors_enabled = enabled;
    if (enabled) stepper_enable();
    else         stepper_disable();
    LOGX_EMIT_I(TAG, "motors %s", enabled ? "enabled" : "disabled");
}

bool motion_motors_enabled(void) { return s_motors_enabled; }

bool motion_spinning_az(void)
{
    bool v;
    portENTER_CRITICAL(&s_spin_lk);
    v = s_spinning_az;
    portEXIT_CRITICAL(&s_spin_lk);
    return v;
}

bool motion_spinning_el(void)
{
    bool v;
    portENTER_CRITICAL(&s_spin_lk);
    v = s_spinning_el;
    portEXIT_CRITICAL(&s_spin_lk);
    return v;
}

void motion_zero(bool do_az, bool do_el)
{
    motion_set_calibration(do_az, do_el, CAL_MODE_CURRENT, 0.0f, 0.0f);
}

float motion_get_az_zero_raw(void) { return s_az_zero_raw; }
float motion_get_el_zero_raw(void) { return s_el_zero_raw; }

esp_err_t motion_set_calibration(bool do_az, bool do_el,
                                 motion_cal_mode_t mode,
                                 float manual_az_raw, float manual_el_raw)
{
    if (!do_az && !do_el) return ESP_ERR_INVALID_ARG;

    float raw;
    if (do_az) {
        switch (mode) {
            case CAL_MODE_CURRENT:
                if (encoder_read_locked(ENC_AZ, &raw) == ESP_OK) s_az_zero_raw = raw;
                else return ESP_FAIL;
                break;
            case CAL_MODE_EXPLICIT: s_az_zero_raw = manual_az_raw; break;
            case CAL_MODE_RESET:    s_az_zero_raw = CAL_DEFAULT_AZ_RAW; break;
            default: return ESP_ERR_INVALID_ARG;
        }
        s_pos.az_deg = 0.0f;
        LOGX_EMIT_I(TAG, "calibrate AZ: zero_raw=%.3f°", (double)s_az_zero_raw);
    }
    if (do_el) {
        switch (mode) {
            case CAL_MODE_CURRENT:
                if (encoder_read_locked(ENC_EL, &raw) == ESP_OK) s_el_zero_raw = raw;
                else return ESP_FAIL;
                break;
            case CAL_MODE_EXPLICIT: s_el_zero_raw = manual_el_raw; break;
            case CAL_MODE_RESET:    s_el_zero_raw = CAL_DEFAULT_EL_RAW; break;
            default: return ESP_ERR_INVALID_ARG;
        }
        s_pos.el_deg = 0.0f;
        LOGX_EMIT_I(TAG, "calibrate EL: zero_raw=%.3f°", (double)s_el_zero_raw);
    }

    return calibration_save_to_nvs(do_az, do_el);
}

esp_err_t motion_spin(stepper_axis_t axis, stepper_dir_t dir, uint32_t step_hz)
{
    bool first_axis;

    portENTER_CRITICAL(&s_spin_lk);
    if (axis == STEPPER_AZ && s_spinning_az) {
        portEXIT_CRITICAL(&s_spin_lk);
        return ESP_ERR_INVALID_STATE;
    }
    if (axis == STEPPER_EL && s_spinning_el) {
        portEXIT_CRITICAL(&s_spin_lk);
        return ESP_ERR_INVALID_STATE;
    }
    first_axis = !s_spinning_az && !s_spinning_el;
    if (axis == STEPPER_AZ) s_spinning_az = true;
    else                    s_spinning_el = true;
    portEXIT_CRITICAL(&s_spin_lk);

    if (first_axis) {
        if (xSemaphoreTake(s_move_mutex, 0) != pdTRUE) {
            portENTER_CRITICAL(&s_spin_lk);
            if (axis == STEPPER_AZ) s_spinning_az = false;
            else                    s_spinning_el = false;
            portEXIT_CRITICAL(&s_spin_lk);
            return ESP_ERR_INVALID_STATE;
        }
    }

    stepper_enable();
    s_motors_enabled = true;
    esp_err_t ret = stepper_spin(axis, dir, step_hz);
    if (ret != ESP_OK) {
        portENTER_CRITICAL(&s_spin_lk);
        if (axis == STEPPER_AZ) s_spinning_az = false;
        else                    s_spinning_el = false;
        bool none_after = !s_spinning_az && !s_spinning_el;
        portEXIT_CRITICAL(&s_spin_lk);
        if (first_axis && none_after)
            xSemaphoreGive(s_move_mutex);
        return ret;
    }

    s_state = MOTION_SPINNING;
    LOGX_EMIT_I(TAG, "spin %s %s @%luHz",
                axis == STEPPER_AZ ? "AZ" : "EL",
                dir == DIR_CW ? "CW" : "CCW",
                (unsigned long)step_hz);
    return ESP_OK;
}

void motion_spin_stop(bool stop_az, bool stop_el)
{
    bool did_az, did_el;

    portENTER_CRITICAL(&s_spin_lk);
    did_az = stop_az && s_spinning_az;
    did_el = stop_el && s_spinning_el;
    portEXIT_CRITICAL(&s_spin_lk);

    if (did_az) {
        stepper_stop(STEPPER_AZ);
        LOGX_EMIT_I(TAG, "spin AZ stopped");
    }
    if (did_el) {
        stepper_stop(STEPPER_EL);
        LOGX_EMIT_I(TAG, "spin EL stopped");
    }

    portENTER_CRITICAL(&s_spin_lk);
    if (did_az) s_spinning_az = false;
    if (did_el) s_spinning_el = false;
    bool none = !s_spinning_az && !s_spinning_el;
    portEXIT_CRITICAL(&s_spin_lk);

    if (none) {
        s_state = MOTION_IDLE;
        xSemaphoreGive(s_move_mutex);
    }
}

/* ── Closed-loop move ───────────────────────────────────────────────────── */

/** Per-axis control state for one closed-loop move. */
typedef struct {
    bool          active;     /* axis is part of this move        */
    bool          settled;    /* reached tolerance (debounced)    */
    float         target;     /* target user-deg                  */
    uint32_t      hz_max;     /* per-axis top step rate           */
    float         kp;         /* per-axis gain (Hz per °)         */
    uint32_t      cur_hz;     /* current commanded step rate      */
    bool          running;    /* stepper currently spinning       */
    stepper_dir_t dir;        /* current spin direction           */
    int           in_tol;     /* consecutive in-tolerance ticks   */
} axis_loop_t;

/**
 * One control tick for one axis: P law (error → step rate), slew-limited,
 * driving the continuous-spin stepper. The encoder angle is passed in so the
 * caller can batch both axes' reads.
 */
static esp_err_t cl_tick_axis(axis_loop_t *a, stepper_axis_t sax, float current_deg)
{
    if (!a->active || a->settled) return ESP_OK;

    float err  = angle_delta(current_deg, a->target);   /* signed shortest path */
    float aerr = fabsf(err);

    /* Within tolerance — stop and debounce. */
    if (aerr <= CL_TOL_DEG) {
        if (a->running) {
            stepper_stop(sax);
            a->running = false;
            a->cur_hz  = 0;
        }
        if (++a->in_tol >= CL_IN_TOL_TICKS) a->settled = true;
        return ESP_OK;
    }
    a->in_tol = 0;

    /* Proportional law: error → desired step rate, clamped per axis. */
    uint32_t want = (uint32_t)(a->kp * aerr);
    if (want < CL_HZ_MIN)  want = CL_HZ_MIN;
    if (want > a->hz_max)  want = a->hz_max;

    /* Slew-limit the commanded rate — trapezoidal accel, no cold-start stall. */
    if (a->cur_hz + CL_HZ_SLEW < want)       a->cur_hz += CL_HZ_SLEW;
    else if (a->cur_hz > want + CL_HZ_SLEW)  a->cur_hz -= CL_HZ_SLEW;
    else                                     a->cur_hz  = want;
    if (a->cur_hz < CL_HZ_MIN) a->cur_hz = CL_HZ_MIN;

    /* delta ≥ 0 → DIR_CCW (the only sign mapping; see COORDINATES.md §6). */
    stepper_dir_t dir = (err >= 0.0f) ? DIR_CCW : DIR_CW;

    if (!a->running || dir != a->dir) {
        if (a->running) stepper_stop(sax);
        a->dir = dir;
        esp_err_t r = stepper_spin(sax, dir, a->cur_hz);
        if (r != ESP_OK) { a->running = false; return r; }
        a->running = true;
    } else {
        stepper_set_speed(sax, a->cur_hz);
    }
    return ESP_OK;
}

esp_err_t motion_move(float az_deg, float el_deg,
                      bool has_az, bool has_el,
                      uint32_t timeout_ms,
                      motion_pos_t *out)
{
    /* Reject if spinning or another move in progress. */
    if (s_spinning_az || s_spinning_el) return ESP_ERR_INVALID_STATE;
    if (xSemaphoreTake(s_move_mutex, 0) != pdTRUE) return ESP_ERR_INVALID_STATE;

    s_state = MOTION_MOVING;
    stepper_enable();
    s_motors_enabled = true;

    axis_loop_t az = {
        .active = has_az, .target = az_deg,
        .hz_max = CL_HZ_MAX_AZ, .kp = CL_KP_AZ,
    };
    axis_loop_t el = {
        .active = has_el, .target = el_deg,
        .hz_max = CL_HZ_MAX_EL, .kp = CL_KP_EL,
    };

    uint64_t t_start  = esp_timer_get_time() / 1000;
    uint32_t hard_cap = (timeout_ms > 0) ? timeout_ms : CL_HARD_CAP_MS;
    esp_err_t result  = ESP_OK;

    LOGX_EMIT_I(TAG, "move (closed-loop) — AZ %s%.2f° | EL %s%.2f°",
                has_az ? "→" : "skip ", (double)az_deg,
                has_el ? "→" : "skip ", (double)el_deg);

    for (;;) {
        /* Read both encoders; keep last value on a failed read. */
        float raw;
        float cur_az = s_pos.az_deg, cur_el = s_pos.el_deg;
        if (encoder_read_locked(ENC_AZ, &raw) == ESP_OK) {
            cur_az = az_user_from_raw(raw);
            s_pos.az_deg = cur_az;
        }
        if (encoder_read_locked(ENC_EL, &raw) == ESP_OK) {
            cur_el = el_user_from_raw(raw);
            s_pos.el_deg = cur_el;
        }

        esp_err_t ra = cl_tick_axis(&az, STEPPER_AZ, cur_az);
        esp_err_t re = cl_tick_axis(&el, STEPPER_EL, cur_el);
        if (ra != ESP_OK || re != ESP_OK) {
            result = ESP_FAIL;
            break;
        }

        if ((!az.active || az.settled) && (!el.active || el.settled))
            break;   /* both axes within tolerance */

        uint32_t elapsed = (uint32_t)(esp_timer_get_time() / 1000 - t_start);
        if (elapsed >= hard_cap) {
            result = ESP_ERR_TIMEOUT;
            break;
        }

        /* Yield — httpd + the WS pose pump run between control ticks. */
        vTaskDelay(pdMS_TO_TICKS(CL_TICK_MS));
    }

    stepper_stop(STEPPER_AZ);
    stepper_stop(STEPPER_EL);

    /* Final encoder read for accurate reported position. */
    float raw;
    if (encoder_read_locked(ENC_AZ, &raw) == ESP_OK) s_pos.az_deg = az_user_from_raw(raw);
    if (encoder_read_locked(ENC_EL, &raw) == ESP_OK) s_pos.el_deg = el_user_from_raw(raw);

    s_state = MOTION_IDLE;
    if (out) *out = s_pos;

    uint32_t elapsed_ms = (uint32_t)(esp_timer_get_time() / 1000 - t_start);
    LOGX_EMIT_I(TAG, "move done in %lu ms — AZ=%.2f° EL=%.2f° %s",
                (unsigned long)elapsed_ms, s_pos.az_deg, s_pos.el_deg,
                result == ESP_OK ? "OK" : result == ESP_ERR_TIMEOUT ? "TIMEOUT" : "FAIL");

    xSemaphoreGive(s_move_mutex);
    return result;
}
