## firmware/main/Kconfig.projbuild
```kconfig
menu "Orbiter Configuration"

    choice ORBITER_BOARD
        prompt "Board wiring"
        default ORBITER_BOARD_WIRED
        help
            Which stepper wiring the firmware drives. The two encoders are on
            the same pins on both (AZ AS5600 SDA 22 / SCL 23, EL AS5600
            SDA 4 / SCL 16).

        config ORBITER_BOARD_WIRED
            bool "Wired bench (v1 pins)"
            help
                A4988 carriers on jumper wires, as in docs/HARDWARE.md:
                AZ STEP/DIR 25/26, EL STEP/DIR 27/33, shared ENABLE 32.

        config ORBITER_BOARD_SIMPLE
            bool "Orbiter-Simple carrier"
            help
                The Orbiter-Simple PCB: AZ STEP/DIR 26/25, EL STEP/DIR 18/19,
                shared ENABLE 27. Its load outputs (OUT A-D on 12/2/5/17) and
                DSLR remote (32/33) are driven low at boot.
    endchoice

    config ORBITER_WIFI_SSID
        string "WiFi SSID"
        default "your-ssid"
        help
            The SSID of the Wi-Fi network the device should join.

    config ORBITER_WIFI_PASSWORD
        string "WiFi password"
        default "your-password"
        help
            Password for the Wi-Fi network. Leave empty for an open network.

    config ORBITER_WIFI_MAX_RETRY
        int "WiFi max retry count"
        default 10
        help
            Number of reconnect attempts before backing off and waiting.

    config ORBITER_HTTP_PORT
        int "HTTP server port"
        default 80
        help
            Port for the HTTP server.

    config ORBITER_EL_MIN_DEG
        int "Elevation min (deg)"
        default -25
        help
            Lower limit of the elevation axis, in degrees (0 = arm horizontal).
            Hard-enforced by /move. The v2 orbit arm meets the cross rail at
            about -28.8 degrees; -25 leaves a margin for the camera mount.

    config ORBITER_EL_MAX_DEG
        int "Elevation max (deg)"
        default 90
        help
            Upper limit of the elevation axis, in degrees (90 = arm vertical).
            Hard-enforced by /move.

    config ORBITER_AS5600_I2C_TRACE
        bool "Verbose AS5600 I2C trace (UART)"
        default n
        help
            Log every I2C register read on both AS5600 encoders at INFO,
            including retry attempts and error codes. Rebuild after change.

endmenu
```
